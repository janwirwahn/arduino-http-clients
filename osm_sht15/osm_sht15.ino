/*Jan Wirwahn, Institute for Geoinformatics, 
Feb. 2014 
Arduino Web-Client for pushing temperature and humidity measurements (SHT15) 
to the OpenSenseMap server. 
Note that MAC-adress and IP has to be changed according to your setup
Disable Serial.print functions for better performance on your stand-alone sensor setup. */ 

#include <SHT1x.h>
#include <SPI.h>
#include <Ethernet.h>
#define dataPin 5
#define clockPin 4
SHT1x sht15(dataPin, clockPin);

//INDIVIDUAL SETUP
//Change MAC-adress here:
byte mac[] = { 0x90, 0xA2, 0xDA, 0x0D, 0x86, 0x46 }; 

//Specify an IP according to your network settings:
IPAddress ip(192,168,1,111);
//The following IDs were generated by the OSM-server. Change them to your IDs:

//register on opensensemap.org 
//they will create database entries and send you the IDs
String arduinoId = ""; //insert SENSEBOX_ID
String tempSensorId = "";//specify SHT15 as temperature sensor to get a TEMPERATURESENSOR_ID
String humiSensorId = "";//specify SHT15 as humidity sensor to get a HUMIDITYSENSOR_ID


char server[] = "opensensemap.org";
EthernetClient client;
float temperature = 0;
float humidity = 0;
int postInterval = 60000; 

//post sample each 10 minutes
long timeOld = 0;
long timeNew = 0;
void setup()
{
  Serial.begin(9600); 
//Try DHCP first 
  if (Ethernet.begin(mac) == 0) 
  {
    Serial.println("Failed to configure Ethernet using DHCP"); 
    Ethernet.begin(mac, ip); 
  } 
  delay(1000);
}

void loop()
{ 
  timeNew = millis(); 
  if (timeNew - timeOld > postInterval)
  { 
    float temp = sht15.readTemperatureC(); 
    postObservation(temp, tempSensorId, arduinoId); 
    delay(2000); 
    float humi = sht15.readHumidity(); 
    postObservation(humi, humiSensorId, arduinoId); 
    timeOld = millis(); 
  }
}

void postObservation(float measurement, String sensorId, String boxId)
{ 
  char obs[10]; 
  dtostrf(measurement, 5, 2, obs);
  Serial.println(obs); 
  //json must look like: {"value":"12.5"} 
  //post observation to: http://opensensemap.org:8000/boxes/boxId/sensorId
  Serial.println("connecting..."); 
  String value = "{\"value\":"; 
  value += obs; 
  value += "}"; 
  // if you get a connection, report back via serial: 
  boxId += "/"; 
  if (client.connect(server, 8000)) 
  {
    Serial.println("connected"); 
    // Make a HTTP Post request: 
    client.print("POST /boxes/"); 
    client.print(boxId);
    client.print("/"); 
    client.print(sensorId); 
    client.println(" HTTP/1.1"); 
    // Send the required header parameters 
    client.println("Host:opensensemap.org"); 
    client.println("Content-Type: application/json"); 
    client.println("Connection: close");  
    client.print("Content-Length: "); 
    client.println(value.length()); 
    client.println(); 
    client.print(value); 
    client.println(); 
  } 
  waitForResponse();
}

void waitForResponse()
{ 
  // if there are incoming bytes available 
  // from the server, read them and print them: 
  boolean repeat = true; 
  do{ 
    if (client.available()) 
    { 
      char c = client.read();
      Serial.print(c); 
    } 
    // if the servers disconnected, stop the client: 
    if (!client.connected()) 
    {
      Serial.println();
      Serial.println("disconnecting."); 
      client.stop(); 
      repeat = false; 
    } 
  }
  while (repeat);
}
